## drivers/input/touchscreen/Asus/Kconfig
```kconfig
#
# Asus Touchscreen Driver Configuration
#
config TOUCHSCREEN_HIMAX_CHIPSET
	bool "Himax touchpanel CHIPSET"
	depends on I2C
	help
	  Say Y here if you have a Himax CHIPSET touchscreen.
	  HIMAX controllers are multi touch controllers which can
	  report 10 touches at a time.

          If unsure, say N.

source "drivers/input/touchscreen/Asus/hxchipset/Kconfig"
source "drivers/input/touchscreen/Asus/NVT_Touch/Kconfig"
source "drivers/input/touchscreen/Asus/synaptics_dsx/Kconfig"
```
